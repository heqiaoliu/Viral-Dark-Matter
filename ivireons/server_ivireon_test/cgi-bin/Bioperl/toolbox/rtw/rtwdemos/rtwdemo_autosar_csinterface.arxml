AUTOSAR XML (schema 3.0.2)
package /PortInterface
  client server interface csinterface
    operation counter
      4 x arg, all with type=Double:
        upper: direction=IN
        input: direction=IN
        lower: direction=IN
        output: direction=OUT
