AUTOSAR XML (schema 2.1.2)
standard types defined: Double
