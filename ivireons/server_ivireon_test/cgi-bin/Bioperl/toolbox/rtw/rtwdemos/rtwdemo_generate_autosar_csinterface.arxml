AUTOSAR XML (schema 3.0.2)
package /rtwdemo_autosar
  client server interface csinterface
    operation rtwdemo_autosar_server_operation
      4 x arg, all with type=Double:
        upper: direction=IN
        input: direction=IN
        lower: direction=IN
        output: direction=OUT
