AUTOSAR XML (schema 3.1.4)
package /AUTOSAR/Services
  client server interface NvM: is-service=true
    operation WriteBlock
      arg arg1: type=SInt8, direction=IN
    operation ReadBlock
      arg arg1: type=Double, direction=OUT
