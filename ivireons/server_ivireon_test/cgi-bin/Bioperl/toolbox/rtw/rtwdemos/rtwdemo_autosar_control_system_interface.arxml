AUTOSAR XML (schema 2.1.2)
package /PortInterface
  sender receiver interface valueInterface
    data value: type=Double
