AUTOSAR XML (schema 3.1.4)
standard types defined: Boolean, UInt8
package /DataType
  array type NvM_DestPtr
    element NvM_DestPtr: type=UInt8, max-number-of-elements=65535
package /AUTOSAR/Services
  client server interface NvM: is-service=true
    operation SetRamBlockStatus
      arg RamBlockStatus: type=Boolean, direction=IN
    operation WriteBlock: possible-error=E_NOT_OK
      arg DstPtr: type=NvM_DestPtr, direction=IN
    error E_NOT_OK: error-code=1
