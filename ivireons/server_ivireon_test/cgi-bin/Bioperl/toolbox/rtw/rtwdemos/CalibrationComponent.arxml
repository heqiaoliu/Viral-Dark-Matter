AUTOSAR XML (schema 314)
standard types defined: UInt8
package /ComponentType
  calprm component type CalibrationComponent
    provide port counter: provided-interface=counter
package /PortInterface
  calprm interface counter
    4 x calprm element prototype, all with type=UInt8:
      INC
      K
      LIMIT
      RESET
